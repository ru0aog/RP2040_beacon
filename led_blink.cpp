/**  
 * ============================================================================  
 *  led_blink.cpp — Параллельный bit-bang драйвер RGB WS2812B и монохромных LED  
 *  Версия 2.12 от 2026-10-01, автор RU0AOG  
 * ============================================================================  
 *  
 *  НАЗНАЧЕНИЕ  
 *  ----------  
 *  Обеспечивает универсальную световую индикацию режимов работы радиомаяка,  
 *  позволяя одной прошивке без перекомпиляции работать на трех разных типах плат:  
 *    - Waveshare RP2040-Zero (адресный RGB светодиод WS2812B на GPIO 16);  
 *    - VCC-GND YD-RP2040     (адресный RGB светодиод WS2812B на GPIO 23);  
 *    - Raspberry Pi Pico     (обычный монохромный LED_BUILTIN на GPIO 25).  
 *  
 *  ВЫСОКОСКОРОСТНОЙ ПАРАЛЛЕЛЬНЫЙ REGISTERS BIT-BANG  
 *  -------------------------------------------------  
 *  Управление адресными светодиодами реализовано без использования библиотек и PIO.  
 *  Функция send_raw_byte_parallel выдает байты данных точными калиброванными задержками  
 *  на пустых циклах (for volatile), оптимизированными под ядро Cortex-M0+ на частоте 120-133 МГц.  
 *  Запись производится одновременно по битовой маске RGB_PINS_MASK напрямую в аппаратные  
 *  регистры SIO процессора (sio_hw->gpio_set / gpio_clr), что зажигает светодиоды на обеих  
 *  платах параллельно.  
 *  
 *  ТАЙМИНГИ И АТОМАРНОСТЬ  
 *  ----------------------  
 *  На время формирования пачки импульсов WS2812B прерывания жестко запрещаются  
 *  командами `noInterrupts() / interrupts()`, так как любой джиттер разрушит структуру  
 *  данных чипа. Порядок выдачи цветов строго соответствует спецификации: сначала  
 *  байт Зеленого (G), затем Красного (R) и Синего (B). Для фиксации цвета (Latch)  
 *  линии сбрасываются в LOW на 600 микросекунд.  
 *  
 *  ПРОТОКОЛ WS2812B (программный bit-banging)  
 *  ------------------------------------------  
 *  Адресные светодиоды тактируются вручную, без PIO и без библиотек:  
 *  send_raw_byte_parallel() выдвигает байт старшим битом вперёд, формируя  
 *  тайминги «1»/«0» точными калиброванными задержками на пустых циклах  
 *  (for volatile). Функция помечена __time_critical_func (исполняется из ОЗУ),  
 *  а на время посылки прерывания запрещаются (noInterrupts) — иначе тайминги  
 *  WS2812B собьются. Пины 16 и 23 обновляются ОДНОВРЕМЕННО через регистры  
 *  sio_hw->gpio_set / gpio_clr по битовой маске RGB_PINS_MASK.  
 *  
 *  ПОРЯДОК ЦВЕТА И ФИКСАЦИЯ  
 *  ------------------------  
 *  set_rgb_parallel(r,g,b) шлёт байты в порядке G-R-B (как требует WS2812B),  
 *  затем выдерживает паузу-latch (~600 мкс) для фиксации цвета. Параллельно  
 *  монохромный LED на GPIO 25 просто зажигается, если запрошен любой ненулевой  
 *  цвет, и гасится при (0,0,0).  
 *  
 *  БИТОВЫЕ МАСКИ:  
 *    RGB_PINS_MASK — только адресные WS2812B (GPIO 16 + 23).  
 *    ALL_PINS_MASK — все индикаторы (GPIO 16 + 23 + 25).  
 *  
 *  API:  
 *    ZERO_LED_init()      — инициализация всех трёх GPIO в OUT и гашение.  
 *    ZERO_LED_RED_ON()    — красный (или встроенный LED на Pico).  
 *    ZERO_LED_GREEN_ON()  — зелёный (или встроенный LED на Pico).  
 *    ZERO_LED_BLUE_ON()   — синий  (или встроенный LED на Pico).  
 *    ZERO_LED_OFF()       — погасить все индикаторы.  
 *  
 *  ИСПОЛЬЗУЕМЫЕ БИБЛИОТЕКИ И МОДУЛИ  
 *  -------------------------------  
 *  - Raspberry Pi Pico SDK (BSD-3): hardware/gpio.h, прямой доступ  
 *    к регистрам SIO (sio_hw->gpio_set/gpio_clr), __time_critical_func  
 *  - Arduino core RP2040 (LGPL-2.1): pinMode/digitalWrite,  
 *    noInterrupts()/interrupts(), delayMicroseconds()  
 *  - Модули проекта: led_blink.h, file_manager.h  
 *  - Сторонний код отсутствует: параллельный bit-bang протокола  
 *    WS2812B на регистрах SIO — оригинальная разработка автора,  
 *    без библиотек NeoPixel/FastLED и без PIO.  
 *  
 *  Этот файл — часть RP2040_beacon, распространяется под GPLv3  
 *  (см. LICENSE в корне репозитория).  
 * ============================================================================  
 */

#include <hardware/gpio.h>
#include "led_blink.h"
#include "file_manager.h"

// Определяем маски пинов для всех трех типов плат одновременно
// GPIO16 (Zero), GPIO23 (YD-RP2040), GPIO25 (Обычная Pico / LED_BUILTIN)
#define PIN_ZERO      16
#define PIN_YD        23
#define PIN_PICO      25

// Битовая маска для одновременного управления адресными светодиодами (16 и 23)
const uint32_t RGB_PINS_MASK = (1 << PIN_ZERO) | (1 << PIN_YD);

// Битовая маска вообще для всех используемых светодиодов (16, 23 и 25)
const uint32_t ALL_PINS_MASK = (1 << PIN_ZERO) | (1 << PIN_YD) | (1 << PIN_PICO);

// Параллельная высокоскоростная отправка байта на пины 16 и 23 одновременно
void __time_critical_func(send_raw_byte_parallel)(uint8_t byte_val) {
    for (int i = 7; i >= 0; i--) {
        if ((byte_val >> i) & 1) {
            // Передача логической '1'
            sio_hw->gpio_set = RGB_PINS_MASK;       // Выставляем 16 и 23 в HIGH
            for (volatile int d = 0; d < 22; d++); 
            sio_hw->gpio_clr = RGB_PINS_MASK;       // Сбрасываем 16 и 23 в LOW
            for (volatile int d = 0; d < 8; d++);  
        } else {
            // Передача логического '0'
            sio_hw->gpio_set = RGB_PINS_MASK;       // Выставляем 16 и 23 в HIGH
            for (volatile int d = 0; d < 2; d++); 
            sio_hw->gpio_clr = RGB_PINS_MASK;       // Сбрасываем 16 и 23 в LOW
            for (volatile int d = 0; d < 45; d++); 
        }
    }
}

// Универсальная функция установки состояния индикаторов
void set_rgb_parallel(uint8_t r, uint8_t g, uint8_t b) {
    // если включено гашение индикации - выйти
    if (!led_enable_flag) {
        sio_hw->gpio_clr = ALL_PINS_MASK; // Принудительно сбрасываем пины 16, 23 и 25 в ноль
        return;                           // Экстренный выход без bit-bang трансляции
    }

    // 1. Отправляем битовую посылку на адресные светодиоды
    noInterrupts();
    send_raw_byte_parallel(g); // WS2812B принимает первым байт зеленого (G)
    send_raw_byte_parallel(r); // Затем красного (R)
    send_raw_byte_parallel(b); // Затем синего (B)
    interrupts();
    
    // Формируем паузу (Latch) для фиксации цвета в чипах WS2812B
    sio_hw->gpio_clr = RGB_PINS_MASK;
    delayMicroseconds(600); 

    // 2. Управляем обычным монохромным светодиодом на GPIO25
    // Если запрашивается любой цвет, отличный от нуля — зажигаем его
    if (r > 0 || g > 0 || b > 0) {
        sio_hw->gpio_set = (1 << PIN_PICO);
    } else {
        sio_hw->gpio_clr = (1 << PIN_PICO);
    }
}

// Аппаратная инициализация всех трех каналов индикации
void ZERO_LED_init() {
  if (led_enable_flag) {
    // Инициализируем GPIO16
    gpio_init(PIN_ZERO);
    gpio_set_dir(PIN_ZERO, GPIO_OUT);
    // Инициализируем GPIO23
    gpio_init(PIN_YD);
    gpio_set_dir(PIN_YD, GPIO_OUT);
    // Инициализируем GPIO25
    gpio_init(PIN_PICO);
    gpio_set_dir(PIN_PICO, GPIO_OUT);
    // Переводим все выводы в состояние LOW
    sio_hw->gpio_clr = ALL_PINS_MASK;
  }

  if (debug_flag) {
    // вывод сообщения
    if (led_enable_flag) {
      Serial.println("[Система] Индикация светодиодом: универсальный режим (YD-RP2040, Pico, Zero)"); }
    else {
      Serial.println("[Система] Индикация светодиодом: отключена");
    }
  }
 
  delay(200); 
}

void ZERO_LED_OFF() {
  // Гасим абсолютно все индикаторы на плате
  set_rgb_parallel(0, 0, 0);
}

// ============================================================================
// МОДИФИЦИРОВАННЫЕ БАЗОВЫЕ ЦВЕТА (Снижена избыточная кислотность)
// ============================================================================
void ZERO_LED_RED_ON() {
  // На Zero и YD-RP2040 загорится красный, на обычной Pico — включится встроенный светодиод
    set_rgb_parallel(180, 0, 0);
}

void ZERO_LED_GREEN_ON() {
    set_rgb_parallel(0, 160, 0);
}

void ZERO_LED_BLUE_ON() {
    set_rgb_parallel(0, 0, 180);
}

// ============================================================================
// НОВЫЕ ПРИЯТНЫЕ И СЛОЖНЫЕ ОТТЕНКИ ДЛЯ РАЗНЫХ РЕЖИМОВ ТРАНСИВЕРА
// ============================================================================

/** @brief Янтарный / Теплый оранжевый цвет. 
 *  Идеален для индикации готовности системы, фиксации частоты VFO в режиме ожидания. */
void ZERO_LED_AMBER_ON() {
    set_rgb_parallel(200, 50, 0); // Плотный красный + немного зеленого дают глубокий янтарь
}

/** @brief Приятный бирюзовый / Морская волна (Cyan). 
 *  Рекомендуется использовать для индикации **активного режима работы SDR-приемника (RX)**. */
void ZERO_LED_CYAN_ON() {
    set_rgb_parallel(0, 120, 140); // Сбалансированное смешение зеленого и синего
}

/** @brief Мягкий пурпурный / Маджента. 
 *  Отлично подойдет для индикации режима **BOOST (активного ВЧ-разгона шины)**. */
void ZERO_LED_MAGENTA_ON() {
    set_rgb_parallel(140, 0, 120);
}

/** @brief Мягкий лимонно-желтый цвет. 
 *  Подходит для индикации работы Guard-систем, например, фазы **Thermal Throttling** (перегрев). */
void ZERO_LED_YELLOW_ON() {
    set_rgb_parallel(140, 110, 0); // Без избыточной ядовитой яркости зеленого
}

/** @brief Лунно-белый цвет сниженной интенсивности. 
 *  Используется как нейтральный индикатор питания, не утомляющий зрение оператора в темноте. */
void ZERO_LED_WHITE_LOW() {
    set_rgb_parallel(45, 50, 45); // Равномерное деление токов по каналам, всего ~18% яркости
}

/** @brief Глубокий индиго / Фиолетовый. 
 *  Приятный глазу цвет. Можно задействовать при включении **узкополосного режима Olivia (`vfo_set_narrowband(true)`)**. */
void ZERO_LED_PURPLE_DEEP() {
    set_rgb_parallel(60, 0, 150);
}

/** @brief Благородный изумрудно-зеленый. 
 *  Более мягкий и премиальный оттенок, чем базовый зеленый. Хорош для статуса "Синхронизация PLL завершена". */
void ZERO_LED_EMERALD_ON() {
    set_rgb_parallel(0, 140, 40);
}

