/**  
 * ============================================================================  
 *  rx_dsp.cpp — модуль децимирующего DSP-тракта (core1)  
 *  Версия 2.26 от 2026-10-20, автор RU0AOG  
 *  
 *  Тракт: 32-бит слова [I|Q] из rx_capture → центрирование → NCO-сдвиг →  
 *  3 каскада half-band FIR (/8) → SPSC-очередь базовой полосы  
 *  int16 I/Q по 64 отсчёта на блок.  
 *  
 *  Fs на канал = RX_ADC_SAMPLE_RATE_HZ/2 (~125 ksps при 250k слов/с),  
 *  Fs_out = Fs/8 ≈ 15.6 ksps на канал (Nyquist ±7.8 кГц — покрывает  
 *  полосу всех узкополосных модов и ПЧ-сдвиг).  
 * ============================================================================  
 */  
  
#include <Arduino.h>  
#include "vfo_hardware.h"  
#include "pico/multicore.h"  
  
// ---- Параметры тракта ----  
#define RX_FS_IN_HZ           (RX_ADC_SAMPLE_RATE_HZ / 2.0f)    // Fs на канал  
#define RX_DECIM_STAGES       3                                 // кол-во последовательных КИХ-фильтров (3)
#define RX_FS_OUT_HZ          (RX_FS_IN_HZ / 8.0f)              // ~15.6 ksps при 250k  
  
// NCO: 32-битный фазовый аккумулятор  
static volatile uint32_t nco_phase = 0;  
static volatile uint32_t nco_step  = 0;     // 2^32 * f_nco / Fs_in  
  
// sin/cos LUT: 1024 точки, Q15, квадратурная пара  
// табличная генерация опорного гармонического сигнала (LUT — Look-Up Table)
static int16_t nco_lut[1024];       // таблица LUT 1024*16бит = 2 кБ
// Функция заполняет таблицу одним полным периодом идеальной синусоиды
// на целочисленном CPU функция медленная!
static void nco_lut_init(void) {
    for (int i = 0; i < 1024; i++)  
        nco_lut[i] = (int16_t)(32767.0f * sinf(2.0f * PI * i / 1024.0f));  
}
// быстрое извлечение квадратурной пары (синуса и косинуса) из заранее подготовленной таблицы
static inline void nco_sincos(uint32_t ph, int16_t* s, int16_t* c) {  
    uint16_t idx = ph >> 22;                // Битовый сдвиг фазы. Старшие 10 бит
    *s = nco_lut[idx];                      // Извлечение синуса
    *c = nco_lut[(idx + 256) & 1023];       // Извлечение косинуса. cos = sin сдвинутый на 90°  
}  
  
// ---- Half-band FIR, 15 отводов, коэффициенты для децимации на 2 ----  
// Стандартный HB-фильтр с окном Хэмминга: в массиве нулевые элементы находятся на нечётных индексах 1, 3, 5, 9, 11 и 13. 
// Центральный индекс - 7. Общий масштаб 1.0 = 32768
// Коэффициенты представлены в целочисленном формате фиксированной запятой Q15
// Симметричные коэффициенты обеспечивают линейную фазу и постоянную групповую задержку в рабочей полосе.
// Это не означает полного отсутствия фазового сдвига.
// Нулевые коэффициенты теоретически позволяют исключить часть операций умножения при оптимизации компилятором
static const int16_t hb_taps[15] = {
    -120,     0,   532,     0, -2250,
       0, 10030, 16384, 10030,     0,
    -2250,     0,   532,     0,  -120
};
#define HB_NTAPS 15        // 15 отводов

typedef struct {
    int32_t d[HB_NTAPS];   // линия задержки (накопленные I или Q)  
    uint8_t w;             // указатель записи  
    uint8_t phase;         // свой бит чётности на каждый канал — I и Q независимы  
} hb_state_t;

static hb_state_t hb_i[RX_DECIM_STAGES], hb_q[RX_DECIM_STAGES];

// реализует один шаг фильтрации и децимации (прореживания) данных через Half-Band FIR (КИХ) фильтр
static inline bool hb_push(hb_state_t* st, int32_t x, int32_t* out) {
    // Новый входящий отсчёт x записывается в историю фильтра (линию задержки st->d) по текущему указателю записи st->w
    st->d[st->w] = x;
    // Указатель st->w сдвигается на следующий элемент
    // Операция % HB_NTAPS (в данном случае % 15) зацикливает массив,
    // обеспечивает циклический переход индекса в программном коде, который компилятор может оптимизировать.
    st->w = (st->w + 1) % HB_NTAPS;
    // Прореживание частоты на 2
    st->phase ^= 1;     // Переменная st->phase это однобитный триггер чётности 
    // (флаг, который при каждом вызове функции переключается между 0 и 1 с помощью операции XOR ^= 1)
    // Если шаг нечётный (st->phase == 1), функция просто сохраняет семпл в историю и мгновенно выходит, возвращая false
    if (st->phase) return false;      // нечётный вход — выхода нет
    // Математическое вычисление свертки КИХ-фильтра
    int32_t acc = 0;    // аккумулятор сбрасывается в ноль
    // Запускается цикл свертки на 15 отводов (HB_NTAPS)
    for (int k = 0; k < HB_NTAPS; k++) {
        // быстрое вычисление правильного физического индекса внутри кольцевого массива, 
        // начиная от самой старой сохраненной точки к самой новой
        int idx = (int)st->w + k; if (idx >= HB_NTAPS) idx -= HB_NTAPS;
        // цифровое умножение отсчёта сигнала на соответствующий коэффициент фильтра (hb_taps)
        acc += (int32_t)st->d[idx] * hb_taps[k];  
    }
    // Масштабирование и выдача готового отсчёта
    *out = acc >> 15;
    return true;
}

// 16-битный ограничитель
static inline int16_t sat16(int32_t v) {
// Если значение превысило верхний порог 32767, оно жестко ограничивается до максимума 32767
// Если значение ушло ниже минимального порога -32768, оно ограничивается снизу до -32768
// Если значение находится в безопасных пределах, оно возвращается без изменений
    if ((v >> 15) ^ (v >> 31)) {
        return (v >> 31) ^ 0x7FFF;
    }
    return (int16_t)v;
}

#define RX_OUT_SAMPLES   (RX_BLOCK_SAMPLES / 8)     // 64 пары отсчётов I/Q на блок  
#define RX_OUT_BUFS      4                          // кол-во выходных буферов

static int16_t out_i[RX_OUT_BUFS][RX_OUT_SAMPLES];  // выходные буферы обработанных данных I/Q
static int16_t out_q[RX_OUT_BUFS][RX_OUT_SAMPLES];
static volatile uint8_t  out_head = 0;              // запись: только core1  
static volatile uint8_t  out_tail = 0;              // запись: только core0  
static volatile uint32_t out_dropped = 0;           // диагностика переполнений  
static int32_t dc_i = 2048 << 8;
static int32_t dc_q = 2048 << 8;

// бесконечный изолированный рабочий цикл ядра Core 1
// цифровой преобразователь частоты вниз (DDC — Digital Down Converter)
static void __not_in_flash_func(rx_dsp_entry)(void) {  
    // бесконечный цикл ядра Core 1
    while (true) {
        // кормим собачку
        watchdog_update();
        // проверяем очередь АЦП (функция в rx_capture.cpp)
        const volatile uint32_t* blk = rx_capture_get_block();
        // если данных ещё нет - на следующую итерацию
        if (!blk) {
            tight_loop_contents();  // подсказка компилятору для цикла ожидания; в этой итерации новых данных нет
            continue;
        }
        // данные из DMA пришли
        uint8_t wr        = out_head;                           // индекс текущего свободного буфера выходной очереди
        uint8_t next_head = (uint8_t)((wr + 1) % RX_OUT_BUFS);  // следующий шаг кольцевого буфера
        // Если очередь полна (queue_full == true), код не останавливает работу. 
        // Блок всё равно будет обработан, чтобы не разорвать внутренние состояния 
        // цифрового гетеродина и фильтров, но результат в конце будет просто сброшен в мусорку.
        bool    queue_full = (next_head == out_tail);
        uint8_t n_out = 0;
        // устанавливаем указатель
        const volatile int16_t* s = (const volatile int16_t*)blk;
        // DMA_SIZE_16: каждое 32-битное слово FIFO = пара отсчётов  
        // [15:0] = ADC0 (I), [31:16] = ADC1 (Q). Пар в блоке = RX_BLOCK_SAMPLES. 
        // внутренний цикл обработки блока данных. Обрабатываем пары I/Q
        for (int n = 0; n < RX_BLOCK_SAMPLES; n++) {
            // извлекаем текущие отсчёты из массива
            int32_t i_meas = s[2 * n];
            int32_t q_meas = s[2 * n + 1];

//обходка DC и NCO
    int32_t i_raw = i_meas;  
    int32_t q_raw = q_meas;
    int32_t i_rot = i_raw;
    int32_t q_rot = q_raw;
/*
            // Центрирование
                // EMA с коэффициентом 1/256
                dc_i += (i_meas - (dc_i >> 8));        // dc в Q8  
                dc_q += (q_meas - (dc_q >> 8));
                // текущее вычисленное среднее (сдвинутое обратно на 8 бит вправо)
                // вычитается из измерений.
                // Получаем сигнал в i_raw и q_raw, компенсированный от постоянного смещения
                int32_t i_raw = i_meas - (dc_i >> 8);  
                int32_t q_raw = q_meas - (dc_q >> 8);  
  
            // Комплексный перенос частоты (Смеситель NCO)
                int16_t sn, cs;
                // Из таблицы синусов (NCO LUT) берутся значения опорного сигнала нужной частоты подстройки
                nco_sincos(nco_phase, &sn, &cs);
                // Фазовый аккумулятор продвигается вперед на величину nco_step
                nco_phase += nco_step;
                // Производится комплексное умножение вектора входного сигнала на вектор гетеродинирования
                // Сдвиг >> 15 возвращает результат из формата Q15 обратно к обычным целым числам
                // После этой операции целевой радиосигнал математически смещается в нулевую промежуточную частоту
                int32_t i_rot = (i_raw * cs + q_raw * sn) >> 15;
                int32_t q_rot = (q_raw * cs - i_raw * sn) >> 15;
*/
            // Трехкаскадная Half-Band фильтрация и децимация
            int32_t vi = i_rot, vq = q_rot;  
            bool emit = true;
                // цепочка последовательных КИХ-фильтров (RX_DECIM_STAGES = 3)
                for (int st = 0; st < RX_DECIM_STAGES; st++) {  
                    int32_t oi, oq;
                    // hb_push укладывает данные в линию задержки очередного каскада
                    bool ri = hb_push(&hb_i[st], vi, &oi);  
                    bool rq = hb_push(&hb_q[st], vq, &oq);
                    // Если хотя бы один из каскадов на текущем шаге вернул false (выхода нет, сработал пропуск прореживания)
                    if (!ri || !rq) {  // флаг emit сбрасывается в false, и обработка текущего отсчета завершается
                        emit = false;
                        break; }
                    vi = oi; vq = oq;
            // частота дискретизации на выходе каскада падает ровно в 2*2*2 = 8 раз
            }

            // Насыщение и запись в буфер базовой полосы
            // Если фильтры выдали отсчет (emit == true), выходная очередь не полна, и мы не вылезли за размер блока (64 отсчета)
            if (emit && !queue_full && n_out < RX_OUT_SAMPLES) {
                // данные проходят через функцию ограничения sat16 (защита от клиппинга)
                // и записываются в выходной буфер out_i/out_q под текущим индексом n_out
                out_i[wr][n_out] = sat16(vi);
                out_q[wr][n_out] = sat16(vq);
                n_out++;
            }
        }
        // После окончания внутреннего цикла 
        // функция rx_capture_release() сообщает DMA-движку на Core 0,
        // что входной буфер blk полностью обработан и его можно использовать повторно
        rx_capture_release();
        // Если выходная очередь была переполнена, инкрементируется диагностический счетчик потерь out_dropped
        if (queue_full) {  
            out_dropped++;            // блок выхода потерян, вход обработан  
        } else {
            // Если всё в порядке, инструкция барьера памяти __dmb() 
            // принудительно обеспечивает порядок операций с памятью между ядрами.
            // Только после этого индекс out_head сдвигается на next_head, делая новый блок видимым для декодеров на Core 0
            __dmb();                  // данные блока видимы до публикации head  
            out_head = next_head;
        }
    }
}


// ---- Публичный API ----  
  
// запуск цифрового сигнального процессора (DSP) на втором ядре (Core 1)
void rx_dsp_start(float f_target_hz) {  
    // Остановка ядра
    // Принудительно гасит Core 1, исключая состояние гонки данных
    multicore_reset_core1();
    // Очистка памяти
    // Полностью обнуляет буферы фильтров промежуточной частоты 
    // и кольцевую межъядерную очередь
    memset(hb_i, 0, sizeof(hb_i));
    memset(hb_q, 0, sizeof(hb_q));
    memset(out_i, 0, sizeof(out_i));
    memset(out_q, 0, sizeof(out_q));
    out_head = out_tail = 0;
    out_dropped = 0;
    dc_i = 2048 << 8;
    dc_q = 2048 << 8;
    // Инициализация гетеродина
    // Генерирует в ОЗУ таблицу синусов для быстрого смешивания частот
    nco_lut_init();
    // Расчет шага сетки NCO
    // Вычисляет точную математическую разницу между желаемой частотой приема
    // и фактической частотой аппаратного генератора для цифровой подстройки
    float f_nco = f_target_hz - (float)vfo_quadrature_lo_hz();
    double step = 4294967296.0 * (double)f_nco / (double)RX_FS_IN_HZ;
    int64_t signed_step = (int64_t)step;
    nco_step = (uint32_t)signed_step;
    nco_phase = 0;
    // вывод диагностики
    Serial.printf("[RXDBG] target=%.1f  lo_actual=%lu  f_nco=%.3f  nco_step=0x%08lX\n",  
                  (double)f_target_hz,  
                  (unsigned long)vfo_quadrature_lo_hz(),  
                  (double)f_nco,  
                  (unsigned long)nco_step);  
    
    // Старт конвейера
    // Запускает изолированный DSP-процесс rx_dsp_entry на Core 1
    multicore_launch_core1(rx_dsp_entry);  
}

// динамическое изменение частоты цифрового гетеродина (NCO) «на лету», прямо во время работы приёмника
// используется алгоритмами автоматической подстройки частоты (AFC)
void rx_dsp_set_nco_hz(float f_hz) {
    double step = 4294967296.0 * (double)f_hz / (double)RX_FS_IN_HZ;
    int64_t signed_step = (int64_t)step;
    nco_step = (uint32_t)signed_step;
}

// Функция реализует безопасное и неблокирующее извлечение отфильтрованных блоков данных из межъядерной SPSC-очереди
// Её вызывает потребитель (consumer) — управляющее ядро Core 0,
// чтобы забрать очищенный сигнал базовой полосы и передать его на вход декодерам цифровых мод
bool rx_dsp_get_output(const int16_t** i, const int16_t** q, uint8_t* n) {
    // текущий индекс чтения out_tail
    uint8_t tail = out_tail;
    // сравнение с индексом записи out_head
    // Если индексы равны, это означает, что математический движок еще не успел подготовить новый блок данных
    if (tail == out_head) return false;    // очередь пуста
      // После наблюдения нового head данные опубликованного блока
      // должны быть видимы до того, как consumer начнёт их читать
    __dmb();
    // Передача указателей на буферы данных
    *i = out_i[tail];
    *q = out_q[tail];
    *n = RX_OUT_SAMPLES;
    return true;
}

// завершает цикл межъядерного обмена данными базовой полосы
// Ее вызывает потребитель (consumer) на Core 0 строго после того,
// как текущий блок из 64 пар I/Q отсчетов был полностью прочитан и обработан декодером цифровой моды
void rx_dsp_release_output(void) {
    // Защитный барьер памяти
    // Все чтения текущего блока должны завершиться до освобождения слота
    __dmb();
    // Продвижение хвоста очереди вперед
    // Текущий буфер помечается как освобожденный. Индекс чтения out_tail сдвигается на единицу вперед
    // Операция остатка от деления % RX_OUT_BUFS (в данном случае % 4) обеспечивает
    // кольцевое зацикливание индекса: после слота 3 он автоматически сбросится в 0
    out_tail = (uint8_t)((out_tail + 1) % RX_OUT_BUFS);
}

// Счётчик потерянных выходных блоков — для диагностики захвата
// возвращает текущее значение счётчика потерянных блоков
// Для чистого спектрального измерения приращение за захват должно быть 0
// Если out_dropped увеличивается, выходной блок был отброшен, поскольку на момент проверки очередь была заполнена.
// Это может указывать на то, что Core 0 не успевает забирать блоки.
// Сам счётчик не определяет первопричину переполнения и не подтверждает отсутствие потерь на входе.
uint32_t rx_dsp_out_dropped(void) {
    return out_dropped;
    }

// возвращает фактическую частоту дискретизации сигнала базовой полосы на выходе DSP-тракта
// нужна декодерам для таймингов
// RX_FS_OUT_HZ 15625 Гц при входной скорости АЦП в 250 кГц
float rx_dsp_fs_out(void) {
    return RX_FS_OUT_HZ;
    }


// Останавливает DSP-тракт: снимает core1 и гасит выходную очередь.
// Вызывается из rx off до rx_capture_stop — иначе core1 продолжит
// крутиться на освобождённых DMA-буферах.
void rx_dsp_stop(void) {
    multicore_reset_core1();   // гасим DSP-ядро
    out_head = out_tail = 0;
    out_dropped = 0;
}



