/**    
 * ============================================================================    
 *  thor_modem.cpp — Общий IFK/MFSK-движок: THOR 8/11, MFSK16, DominoEX 8, FSQ
 *  + генератор RSID (общий для THOR-семейства и Olivia/Contestia)
 *  Алгоритмы адаптированы из fldigi (GPLv3, David Freese W1HKJ и др.)
 * ============================================================================    
 *  Общая инфраструктура:    
 *    mfsk_prepare(base, step, n) — сетка n<=33 тонов: регистровые пакеты    
 *        DATA_MFSK[33][8] для Si5351 либо vfo_hardware_init(base, step) (PIO).    
 *    mfsk_emit_tone(tone, symbol_us) — тон + ожидание абсолютного дедлайна,    
 *        LED, контроль прерывания, watchdog.    
 *    rsid_send(code, center) — RSID fldigi: 15 символов GF(16), 16 тонов    
 *        11025/1024 Гц, 92.88 мс, перед ним 5 символов тишины.    
 *    
 *  Режимы:    
 *    THOR 11 : 18 тонов, varicode -> FEC k=7 -> перемежитель 4x10 -> IFK+ (+2)    
 *    MFSK16  : 16 тонов 15.625 Гц, 64 мс; varicode -> FEC k=7 -> перемежитель    
 *              4x10 -> код Грея -> абсолютный тон (без IFK). RSID 57.    
 *    DomEX 8 : 18 тонов 15.625 Гц (2x baud), 128 мс; nibble-varicode,    
 *              IFK+ tone=(prev+nib+2)%18. RSID 86.    
 *    FSQ-4.5 : 33 тона 8.789 Гц (3 бина 12000/4096), 256 мс;    
 *              fsq_varicode, IFK+ tone=(prev+sym+1)%33. Без RSID (в fldigi нет).    
 *    Дизер глушится vfo_set_narrowband(true) на время TX.    
 *    
 *  ---- Производный код / использованные источники -------------------------    
 *  Алгоритмы адаптированы из fldigi (GPLv3, David Freese W1HKJ и др.):    
 *    - thor/thor.cxx, thor.h: свёрточный код k=7 (0x6d,0x4f), перемежитель 4x10,    
 *      IFK+ (+2), тайминги символов, преамбула/флаш    
 *    - mfsk/mfsk.cxx, mfsk.h, mfsk/interleave.cxx, misc/misc.cxx (grayencode):    
 *      MFSK16 — упаковка бит в символы, преамбула, STX/EOT, flush    
 *    - mfsk/mfskvaricode.cxx / thor/thorvaricode.cxx: таблицы varicode    
 *      (varicode IZ8BLY / ZL1BPU MFSK standard)    
 *    - dominoex/dominoex.cxx, dominoex/dominovar.cxx: DominoEX — IFK+, idle,    
 *      таблица nibble-varicode (primary/secondary)    
 *    - fsq/fsq.cxx, fsq/fsq_varicode.cxx: FSQ — сетка, IFK+, idle, BOL/EOL,    
 *      таблица fsq_varicode    
 *    - rsid/rsid.cxx, rsid/rsid_defs.cxx: кодер RSID (Squares/indices, GF16)    
 *      и номера режимов    
 *    
 * ============================================================================    
 */
  
#include <Arduino.h>  
#include "thor_modem.h"  
#include "vfo_hardware.h"  
#include "si5351_driver.h"  
#include "led_blink.h"  
#include <hardware/watchdog.h>  
  
extern volatile bool pc_file_written;  
extern bool soft_restart_flag;  
extern void check_serial_commands();  
extern bool debug_flag;  
extern uint8_t device_SI[5];
extern String my_call_variable;
extern void si_calculate_freq_bytes_mHz(uint64_t freq_mHz, uint8_t* out_data);  
  
// ---------------- Константы THOR (из thor.cxx / thor.h) ------------------  
#define THOR_NUMTONES   18            // число тонов
#define THOR_K          7             // THOR_K  
#define THOR_POLY1      0x6d          // THOR_POLY1  
#define THOR_POLY2      0x4f          // THOR_POLY2  
#define THOR_IL_SIZE    4             // interleave size  
#define THOR_IL_DEPTH   10            // 
#define THOR_INVERT_TONES 0           // A/B боковой полосы

  
#if THOR_MODE == 8  
  static const double   THOR_STEP_HZ   = 15.625;        // 8000*2/1024  
  static const uint32_t THOR_SYMBOL_US = 128000;        // 1024/8000 с  
#elif THOR_MODE == 11  
  static const double   THOR_STEP_HZ   = 10.7666;       // 11025/1024  
  static const uint32_t THOR_SYMBOL_US = 92879;         // 1024/11025 с  
#else  
  #error "THOR_MODE must be 8 or 11"  
#endif  

// Длины преамбулы/хвоста для сброса FEC+перемежителя (мимикрия thor tx_process)  
#define THOR_PREAMBLE_CHARS  4        // <<< СВЕРИТЬ с thor::tx_process (preamble)  
#define THOR_FLUSH_CHARS     8        // <<< СВЕРИТЬ (FLUSHLENGTH)  

// ---------------- MFSK16 (mfsk.cxx: SR 8000, symlen 512) -----------------
#define MFSK16_NUMTONES      16
static const double   MFSK16_STEP_HZ   = 15.625;         // 8000/512
static const uint32_t MFSK16_SYMBOL_US = 64000;          // 512/8000 с
#define MFSK16_PREAMBLE      107                         // mfsk.cxx: preamble
#define MFSK16_RSID_CODE     57                          // rsid_defs: MFSK16

// ---------------- DominoEX 8 (dominoex.cxx: SR 8000, symlen 1024) --------
#define DOMEX_NUMTONES       18
static const double   DOMEX8_STEP_HZ   = 15.625;         // doublespaced: 2*8000/1024
static const uint32_t DOMEX8_SYMBOL_US = 128000;         // 1024/8000 с (7.8125 бод)
#define DOMEX8_RSID_CODE     86                          // rsid_defs: DOMINOEX_8

// ---------------- FSQ (fsq.cxx: SR 12000, FSQ_SYMLEN 4096, spacing 3) ----
#define FSQ_NUMTONES         33
static const double   FSQ_STEP_HZ      = 3.0 * 12000.0 / 4096.0; // 8.7890625 Гц
// Скорость (fsq.cxx: symlen 8192/6144/4096/3072/2048 при 12000 Гц):
// 1.5 бод 682667, 2 бод 512000, 3 бод 341333, 4.5 бод 256000, 6 бод 170667 мкс
static const uint32_t FSQ_SYMBOL_US    = 256000;         // FSQ-4.5: 3072/12000 с

// ---------------- RSID (rsid.cxx) ----------------------------------------
#define RSID_NSYMBOLS        15
static const double   RSID_STEP_HZ     = 11025.0 / 1024.0; // 10.7666 Гц
static const uint32_t RSID_SYMBOL_US   = 92880;            // 1024/11025 с
#define THOR11_RSID_CODE  	 143
#define FSQ_RSID_CODE        114

#define MFSK_MAX_TONES       33

uint32_t THOR_Base_freq     = 3601307;  
uint32_t MFSK16_Base_freq   = 3601307;
uint32_t DOMINOEX_Base_freq = 3601307;
uint32_t FSQ_Base_freq      = 3601307;
uint8_t  DATA_MFSK[MFSK_MAX_TONES][8];  // регистровые пакеты Si5351 текущей сетки

static const double THOR_CENTER_OFFSET_HZ   = (THOR_NUMTONES-1)/2.0 * THOR_STEP_HZ;    // 132.81  
static const double MFSK16_CENTER_OFFSET_HZ = (MFSK16_NUMTONES-1)/2.0 * MFSK16_STEP_HZ; // 117.19  
static const double DOMEX_CENTER_OFFSET_HZ  = (DOMEX_NUMTONES-1)/2.0 * DOMEX8_STEP_HZ;  // 132.81  
static const double FSQ_CENTER_OFFSET_HZ    = (FSQ_NUMTONES-1)/2.0 * FSQ_STEP_HZ;       // 140.63

// ---------------- Varicode (ВЕРБАТИМ из fldigi) --------------------------  
// MFSKvaricode.cxx: varicode[256] (строки '0'/'1'), + varienc()/varidec()  
// thorvaricode.cxx: thor_varicode[] + thorvarienc()  
//  
/*
 * The IZ8BLY MFSK Varicode as defined in
 *   http://www.qsl.net/zl1bpu/MFSK/Varicode.html
 */
static const char *varicode[] = {
	"11101011100",		/* 000 - <NUL>	*/
	"11101100000",		/* 001 - <SOH>	*/
	"11101101000",		/* 002 - <STX>	*/
	"11101101100",		/* 003 - <ETX>	*/
	"11101110000",		/* 004 - <EOT>	*/
	"11101110100",		/* 005 - <ENQ>	*/
	"11101111000",		/* 006 - <ACK>	*/
	"11101111100",		/* 007 - <BEL>	*/
	"10101000",			/* 008 - <BS>	*/
	"11110000000",		/* 009 - <TAB>	*/
	"11110100000",		/* 010 - <LF>	*/
	"11110101000",		/* 011 - <VT>	*/
	"11110101100",		/* 012 - <FF>	*/
	"10101100",			/* 013 - <CR>	*/
	"11110110000",		/* 014 - <SO>	*/
	"11110110100",		/* 015 - <SI>	*/
	"11110111000",		/* 016 - <DLE>	*/
	"11110111100",		/* 017 - <DC1>	*/
	"11111000000",		/* 018 - <DC2>	*/
	"11111010000",		/* 019 - <DC3>	*/
	"11111010100",		/* 020 - <DC4>	*/
	"11111011000",		/* 021 - <NAK>	*/
	"11111011100",		/* 022 - <SYN>	*/
	"11111100000",		/* 023 - <ETB>	*/
	"11111101000",		/* 024 - <CAN>	*/
	"11111101100",		/* 025 - <EM>	*/
	"11111110000",		/* 026 - <SUB>	*/
	"11111110100",		/* 027 - <ESC>	*/
	"11111111000",		/* 028 - <FS>	*/
	"11111111100",		/* 029 - <GS>	*/
	"100000000000",		/* 030 - <RS>	*/
	"101000000000",		/* 031 - <US>	*/
	"100",				/* 032 - <SPC>	*/
	"111000000",		/* 033 - !	*/
	"111111100",		/* 034 - '"'	*/
	"1011011000",		/* 035 - #	*/
	"1010101000",		/* 036 - $	*/
	"1010100000",		/* 037 - %	*/
	"1000000000",		/* 038 - &	*/
	"110111100",		/* 039 - '	*/
	"111110100",		/* 040 - (	*/
	"111110000",		/* 041 - )	*/
	"1010110100",		/* 042 - *	*/
	"111100000",		/* 043 - +	*/
	"10100000",			/* 044 - ,	*/
	"111011000",		/* 045 - -	*/
	"111010100",		/* 046 - .	*/
	"111101000",		/* 047 - /	*/
	"11100000",			/* 048 - 0	*/
	"11110000",			/* 049 - 1	*/
	"101000000",		/* 050 - 2	*/
	"101010100",		/* 051 - 3	*/
	"101110100",		/* 052 - 4	*/
	"101100000",		/* 053 - 5	*/
	"101101100",		/* 054 - 6	*/
	"110100000",		/* 055 - 7	*/
	"110000000",		/* 056 - 8	*/
	"110101100",		/* 057 - 9	*/
	"111101100",		/* 058 - :	*/
	"111111000",		/* 059 - ;	*/
	"1011000000",		/* 060 - <	*/
	"111011100",		/* 061 - =	*/
	"1010111100",		/* 062 - >	*/
	"111010000",		/* 063 - ?	*/
	"1010000000",		/* 064 - @	*/
	"10111100",			/* 065 - A	*/
	"100000000",		/* 066 - B	*/
	"11010100",			/* 067 - C	*/
	"11011100",			/* 068 - D	*/
	"10111000",			/* 069 - E	*/
	"11111000",			/* 070 - F	*/
	"101010000",		/* 071 - G	*/
	"101011000",		/* 072 - H	*/
	"11000000",			/* 073 - I	*/
	"110110100",		/* 074 - J	*/
	"101111100",		/* 075 - K	*/
	"11110100",			/* 076 - L	*/
	"11101000",			/* 077 - M	*/
	"11111100",			/* 078 - N	*/
	"11010000",			/* 079 - O	*/
	"11101100",			/* 080 - P	*/
	"110110000",		/* 081 - Q	*/
	"11011000",			/* 082 - R	*/
	"10110100",			/* 083 - S	*/
	"10110000",			/* 084 - T	*/
	"101011100",		/* 085 - U	*/
	"110101000",		/* 086 - V	*/
	"101101000",		/* 087 - W	*/
	"101110000",		/* 088 - X	*/
	"101111000",		/* 089 - Y	*/
	"110111000",		/* 090 - Z	*/
	"1011101000",		/* 091 - [	*/
	"1011010000",		/* 092 - \	*/
	"1011101100",		/* 093 - ]	*/
	"1011010100",		/* 094 - ^	*/
	"1010110000",		/* 095 - _	*/
	"1010101100",		/* 096 - `	*/
	"10100",			/* 097 - a	*/
	"1100000",			/* 098 - b	*/
	"111000",			/* 099 - c	*/
	"110100",			/* 100 - d	*/
	"1000",				/* 101 - e	*/
	"1010000",			/* 102 - f	*/
	"1011000",			/* 103 - g	*/
	"110000",			/* 104 - h	*/
	"11000",			/* 105 - i	*/
	"10000000",			/* 106 - j	*/
	"1110000",			/* 107 - k	*/
	"101100",			/* 108 - l	*/
	"1000000",			/* 109 - m	*/
	"11100",			/* 110 - n	*/
	"10000",			/* 111 - o	*/
	"1010100",			/* 112 - p	*/
	"1111000",			/* 113 - q	*/
	"100000",			/* 114 - r	*/
	"101000",			/* 115 - s	*/
	"1100",				/* 116 - t	*/
	"111100",			/* 117 - u	*/
	"1101100",			/* 118 - v	*/
	"1101000",			/* 119 - w	*/
	"1110100",			/* 120 - x	*/
	"1011100",			/* 121 - y	*/
	"1111100",			/* 122 - z	*/
	"1011011100",		/* 123 - {	*/
	"1010111000",		/* 124 - |	*/
	"1011100000",		/* 125 - }	*/
	"1011110000",		/* 126 - ~	*/
	"101010000000",		/* 127 - <DEL>	*/
	"101010100000",		/* 128 - 	*/
	"101010101000",		/* 129 - 	*/
	"101010101100",		/* 130 - 	*/
	"101010110000",		/* 131 - 	*/
	"101010110100",		/* 132 - 	*/
	"101010111000",		/* 133 - 	*/
	"101010111100",		/* 134 - 	*/
	"101011000000",		/* 135 - 	*/
	"101011010000",		/* 136 - 	*/
	"101011010100",		/* 137 - 	*/
	"101011011000",		/* 138 - 	*/
	"101011011100",		/* 139 - 	*/
	"101011100000",		/* 140 - 	*/
	"101011101000",		/* 141 - 	*/
	"101011101100",		/* 142 - 	*/
	"101011110000",		/* 143 - 	*/
	"101011110100",		/* 144 - 	*/
	"101011111000",		/* 145 - 	*/
	"101011111100",		/* 146 - 	*/
	"101100000000",		/* 147 - 	*/
	"101101000000",		/* 148 - 	*/
	"101101010000",		/* 149 - 	*/
	"101101010100",		/* 150 - 	*/
	"101101011000",		/* 151 - 	*/
	"101101011100",		/* 152 - 	*/
	"101101100000",		/* 153 - 	*/
	"101101101000",		/* 154 - 	*/
	"101101101100",		/* 155 - 	*/
	"101101110000",		/* 156 - 	*/
	"101101110100",		/* 157 - 	*/
	"101101111000",		/* 158 - 	*/
	"101101111100",		/* 159 - 	*/
	"1011110100",		/* 160 - 	*/
	"1011111000",		/* 161 - Ў	*/
	"1011111100",		/* 162 - ў	*/
	"1100000000",		/* 163 - Ј	*/
	"1101000000",		/* 164 - ¤	*/
	"1101010000",		/* 165 - Ґ	*/
	"1101010100",		/* 166 - ¦	*/
	"1101011000",		/* 167 - §	*/
	"1101011100",		/* 168 - Ё	*/
	"1101100000",		/* 169 - ©	*/
	"1101101000",		/* 170 - Є	*/
	"1101101100",		/* 171 - «	*/
	"1101110000",		/* 172 - ¬	*/
	"1101110100",		/* 173 - ­	*/
	"1101111000",		/* 174 - ®	*/
	"1101111100",		/* 175 - Ї	*/
	"1110000000",		/* 176 - °	*/
	"1110100000",		/* 177 - ±	*/
	"1110101000",		/* 178 - І	*/
	"1110101100",		/* 179 - і	*/
	"1110110000",		/* 180 - ґ	*/
	"1110110100",		/* 181 - µ	*/
	"1110111000",		/* 182 - ¶	*/
	"1110111100",		/* 183 - ·	*/
	"1111000000",		/* 184 - ё	*/
	"1111010000",		/* 185 - №	*/
	"1111010100",		/* 186 - є	*/
	"1111011000",		/* 187 - »	*/
	"1111011100",		/* 188 - ј	*/
	"1111100000",		/* 189 - Ѕ	*/
	"1111101000",		/* 190 - ѕ	*/
	"1111101100",		/* 191 - ї	*/
	"1111110000",		/* 192 - А	*/
	"1111110100",		/* 193 - Б	*/
	"1111111000",		/* 194 - В	*/
	"1111111100",		/* 195 - Г	*/
	"10000000000",		/* 196 - Д	*/
	"10100000000",		/* 197 - Е	*/
	"10101000000",		/* 198 - Ж	*/
	"10101010000",		/* 199 - З	*/
	"10101010100",		/* 200 - И	*/
	"10101011000",		/* 201 - Й	*/
	"10101011100",		/* 202 - К	*/
	"10101100000",		/* 203 - Л	*/
	"10101101000",		/* 204 - М	*/
	"10101101100",		/* 205 - Н	*/
	"10101110000",		/* 206 - О	*/
	"10101110100",		/* 207 - П	*/
	"10101111000",		/* 208 - Р	*/
	"10101111100",		/* 209 - С	*/
	"10110000000",		/* 210 - Т	*/
	"10110100000",		/* 211 - У	*/
	"10110101000",		/* 212 - Ф	*/
	"10110101100",		/* 213 - Х	*/
	"10110110000",		/* 214 - Ц	*/
	"10110110100",		/* 215 - Ч	*/
	"10110111000",		/* 216 - Ш	*/
	"10110111100",		/* 217 - Щ	*/
	"10111000000",		/* 218 - Ъ	*/
	"10111010000",		/* 219 - Ы	*/
	"10111010100",		/* 220 - Ь	*/
	"10111011000",		/* 221 - Э	*/
	"10111011100",		/* 222 - Ю	*/
	"10111100000",		/* 223 - Я	*/
	"10111101000",		/* 224 - а	*/
	"10111101100",		/* 225 - б	*/
	"10111110000",		/* 226 - в	*/
	"10111110100",		/* 227 - г	*/
	"10111111000",		/* 228 - д	*/
	"10111111100",		/* 229 - е	*/
	"11000000000",		/* 230 - ж	*/
	"11010000000",		/* 231 - з	*/
	"11010100000",		/* 232 - и	*/
	"11010101000",		/* 233 - й	*/
	"11010101100",		/* 234 - к	*/
	"11010110000",		/* 235 - л	*/
	"11010110100",		/* 236 - м	*/
	"11010111000",		/* 237 - н	*/
	"11010111100",		/* 238 - о	*/
	"11011000000",		/* 239 - п	*/
	"11011010000",		/* 240 - р	*/
	"11011010100",		/* 241 - с	*/
	"11011011000",		/* 242 - т	*/
	"11011011100",		/* 243 - у	*/
	"11011100000",		/* 244 - ф	*/
	"11011101000",		/* 245 - х	*/
	"11011101100",		/* 246 - ц	*/
	"11011110000",		/* 247 - ч	*/
	"11011110100",		/* 248 - ш	*/
	"11011111000",		/* 249 - щ	*/
	"11011111100",		/* 250 - ъ	*/
	"11100000000",		/* 251 - ы	*/
	"11101000000",		/* 252 - n	*/
	"11101010000",		/* 253 - э	*/
	"11101010100",		/* 254 - ю	*/
	"11101011000"		/* 255 - я	*/
};

static const char *thor_varicode[] = {
	"101110000000",		/* 032 - <SPC>	*/ 
	"101110100000",		/* 033 - !	*/
	"101110101000",		/* 034 - '"'	*/
	"101110101100",		/* 035 - #	*/
	"101110110000",		/* 036 - $	*/
	"101110110100",		/* 037 - %	*/
	"101110111000",		/* 038 - &	*/
	"101110111100",		/* 039 - '	*/
	"101111000000",		/* 040 - (	*/
	"101111010000",		/* 041 - )	*/
	"101111010100",		/* 042 - *	*/
	"101111011000",		/* 043 - +	*/
	"101111011100",		/* 044 - ,	*/
	"101111100000",		/* 045 - -	*/
	"101111101000",		/* 046 - .	*/
	"101111101100",		/* 047 - /	*/
	"101111110000",		/* 048 - 0	*/
	"101111110100",		/* 049 - 1	*/
	"101111111000",		/* 050 - 2	*/
	"101111111100",		/* 051 - 3	*/
	"110000000000",		/* 052 - 4	*/
	"110100000000",		/* 053 - 5	*/
	"110101000000",		/* 054 - 6	*/
	"110101010100",		/* 055 - 7	*/
	"110101011000",		/* 056 - 8	*/
	"110101011100",		/* 057 - 9	*/
	"110101100000",		/* 058 - :	*/
	"110101101000",		/* 059 - ;	*/
	"110101101100",		/* 060 - <	*/
	"110101110000",		/* 061 - =	*/
	"110101110100",		/* 062 - >	*/
	"110101111000",		/* 063 - ?	*/
	"110101111100",		/* 064 - @	*/
	"110110000000",		/* 065 - A	*/
	"110110100000",		/* 066 - B	*/
	"110110101000",		/* 067 - C	*/
	"110110101100",		/* 068 - D	*/
	"110110110000",		/* 069 - E	*/
	"110110110100",		/* 070 - F	*/
	"110110111000",		/* 071 - G	*/
	"110110111100",		/* 072 - H	*/
	"110111000000",		/* 073 - I	*/
	"110111010000",		/* 074 - J	*/
	"110111010100",		/* 075 - K	*/
	"110111011000",		/* 076 - L	*/
	"110111011100",		/* 077 - M	*/
	"110111100000",		/* 078 - N	*/
	"110111101000",		/* 079 - O	*/
	"110111101100",		/* 080 - P	*/
	"110111110000",		/* 081 - Q	*/
	"110111110100",		/* 082 - R	*/
	"110111111000",		/* 083 - S	*/
	"110111111100",		/* 084 - T	*/
	"111000000000",		/* 085 - U	*/
	"111010000000",		/* 086 - V	*/
	"111010100000",		/* 087 - W	*/
	"111010101100",		/* 088 - X	*/
	"111010110000",		/* 089 - Y	*/
	"111010110100",		/* 090 - Z	*/
	"111010111000",		/* 091 - [	*/
	"111010111100",		/* 092 - \	*/
	"111011000000",		/* 093 - ]	*/
	"111011010000",		/* 094 - ^	*/
	"111011010100",		/* 095 - _	*/
	"111011011000",		/* 096 - `	*/
	"111011011100",		/* 097 - a	*/
	"111011100000",		/* 098 - b	*/
	"111011101000",		/* 099 - c	*/
	"111011101100",		/* 100 - d	*/
	"111011110000",		/* 101 - e	*/
	"111011110100",		/* 102 - f	*/
	"111011111000",		/* 103 - g	*/
	"111011111100",		/* 104 - h	*/
	"111100000000",		/* 105 - i	*/
	"111101000000",		/* 106 - j	*/
	"111101010000",		/* 107 - k	*/
	"111101010100",		/* 108 - l	*/
	"111101011000",		/* 109 - m	*/
	"111101011100",		/* 110 - n	*/
	"111101100000",		/* 111 - o	*/
	"111101101000",		/* 112 - p	*/
	"111101101100",		/* 113 - q	*/
	"111101110000",		/* 114 - r	*/
	"111101110100",		/* 115 - s	*/
	"111101111000",		/* 116 - t	*/
	"111101111100",		/* 117 - u	*/
	"111110000000",		/* 118 - v	*/
	"111110100000",		/* 119 - w	*/
	"111110101000",		/* 120 - x	*/
	"111110101100",		/* 121 - y	*/
	"111110110000"		/* 122 - z	*/
};

 static const char *varienc(int c){  
     if (c >= 0 && c < 256) return varicode[c];  
     return varicode[0];  
 }  
 static const char *thorvarienc(int c, int sec){  
     if (sec == 0) return varienc(c);  
     if (c >= ' ' && c <= 'z') return thor_varicode[c - ' '];  
     return varienc(0);  
 }

// ---------------- DominoEX nibble-varicode (ВЕРБАТИМ dominovar.cxx) -----
// varicode[512][3]: 0..255 — primary, 256..511 — secondary алфавит.
// Первый nibble < 8, продолжения имеют старший бит (0x8).
static const uint8_t domino_varicode[512][3] = {
	/* Primary alphabet */
	{ 1,15, 9}, { 1,15,10}, { 1,15,11}, { 1,15,12}, { 1,15,13}, { 1,15,14}, { 1,15,15}, { 2, 8, 8},
	{ 2,12, 0}, { 2, 8, 9}, { 2, 8,10}, { 2, 8,11}, { 2, 8,12}, { 2,13, 0}, { 2, 8,13}, { 2, 8,14},
	{ 2, 8,15}, { 2, 9, 8}, { 2, 9, 9}, { 2, 9,10}, { 2, 9,11}, { 2, 9,12}, { 2, 9,13}, { 2, 9,14},
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	{ 1,14, 9}, { 1,14,10}, { 1,14,11}, { 1,14,12}, { 1,14,13}, { 1,14,14}, { 1,14,15}, { 1,15, 8},

	/* Secondary alphabet */
	{ 6,15, 9}, { 6,15,10}, { 6,15,11}, { 6,15,12}, { 6,15,13}, { 6,15,14}, { 6,15,15}, { 7, 8, 8},
	{ 4,10,12}, { 7, 8, 9}, { 7, 8,10}, { 7, 8,11}, { 7, 8,12}, { 4,10,13}, { 7, 8,13}, { 7, 8,14},
	{ 7, 8,15}, { 7, 9, 8}, { 7, 9, 9}, { 7, 9,10}, { 7, 9,11}, { 7, 9,12}, { 7, 9,13}, { 7, 9,14},
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	{ 6,14, 9}, { 6,14,10}, { 6,14,11}, { 6,14,12}, { 6,14,13}, { 6,14,14}, { 6,14,15}, { 6,15, 8},
};

// ---------------- FSQ varicode (ВЕРБАТИМ fsq_varicode.cxx) ---------------
// fsq_varicode[256][2]: sym1 всегда, sym2 — только если > 28.
static const uint8_t fsq_varicode[256][2] = {
	{ 0, 0}, { 0, 0}, { 0, 0}, { 0, 0}, { 0, 0}, { 0, 0}, { 0, 0}, { 0, 0},   //   0..  7
	{27,31}, { 0, 0}, {28, 0}, { 0, 0}, { 0, 0}, { 0, 0}, { 0, 0}, { 0, 0},   //   8.. 15
	{ 0, 0}, { 0, 0}, { 0, 0}, { 0, 0}, { 0, 0}, { 0, 0}, { 0, 0}, { 0, 0},   //  16.. 23
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	{ 0, 0}, { 0, 0}, { 0, 0}, { 0, 0}, { 0, 0}, { 0, 0}, { 0, 0}, { 0, 0},   // 248..255
};

// ---------------- Свёрточный кодер (viterbi.cxx::encoder) ----------------  
static uint32_t enc_shreg = 0;  
static inline void thor_enc_init() { enc_shreg = 0; }  
// encode(bit): output[i] = parity(poly1 & i) | (parity(poly2 & i) << 1)  
static inline uint8_t thor_encode(uint8_t bit) {  
    enc_shreg = (enc_shreg << 1) | (bit & 1u);  
    uint8_t o0 = (uint8_t)__builtin_parity(enc_shreg & THOR_POLY1);  
    uint8_t o1 = (uint8_t)__builtin_parity(enc_shreg & THOR_POLY2);  
    return (uint8_t)(o0 | (o1 << 1));  
}  
  
// ---------------- Перемежитель (interleave.cxx, INTERLEAVE_FWD) ----------  
// THOR и MFSK16 используют одинаковый перемежитель 4x10.
static uint8_t il_table[THOR_IL_DEPTH * THOR_IL_SIZE * THOR_IL_SIZE];  
static inline uint8_t* il_tab(int i, int j, int k) {  
    return &il_table[(THOR_IL_SIZE*THOR_IL_SIZE*i) + (THOR_IL_SIZE*j) + k];  
}  
static void il_init() { memset(il_table, 0, sizeof(il_table)); } // Tx fill = 0  
static void il_symbols(uint8_t* psyms) {  
    for (int k = 0; k < THOR_IL_DEPTH; k++) {  
        for (int i = 0; i < THOR_IL_SIZE; i++)  
            for (int j = 0; j < THOR_IL_SIZE - 1; j++)  
                *il_tab(k, i, j) = *il_tab(k, i, j + 1);  
        for (int i = 0; i < THOR_IL_SIZE; i++)  
            *il_tab(k, i, THOR_IL_SIZE - 1) = psyms[i];  
        for (int i = 0; i < THOR_IL_SIZE; i++)   // FWD  
            psyms[i] = *il_tab(k, i, THOR_IL_SIZE - i - 1);  
    }  
}  
static void il_bits(uint32_t* pbits) {  
    uint8_t syms[THOR_IL_SIZE];  
    for (int i = 0; i < THOR_IL_SIZE; i++)  
        syms[i] = (uint8_t)((*pbits >> (THOR_IL_SIZE - i - 1)) & 1u);  
    il_symbols(syms);  
    uint32_t v = 0;  
    for (int i = 0; i < THOR_IL_SIZE; i++) v = (v << 1) | syms[i];  
    *pbits = v;  
}  

// ---------------- FEC-конвейер: бит -> кодер -> 4 бита -> перемежитель ---
// (thor::sendchar / mfsk::sendbit). sym_out == nullptr — без выдачи в эфир
// (mfsk::clearbits: прогрев перемежителя нулями).
typedef bool (*fec_sym_fn)(uint8_t sym);
static uint32_t fec_bitshreg = 0;
static int      fec_bitstate = 0;

static void fec_reset() {
    thor_enc_init();
    il_init();
    fec_bitshreg = 0;
    fec_bitstate = 0;
}

static bool fec_send_bit(uint8_t bit, fec_sym_fn sym_out) {
    uint8_t data = thor_encode(bit);
    for (int i = 0; i < 2; i++) {
        fec_bitshreg = (fec_bitshreg << 1) | ((data >> i) & 1u);
        fec_bitstate++;
        if (fec_bitstate == THOR_IL_SIZE) {
            il_bits(&fec_bitshreg);
            if (sym_out && !sym_out((uint8_t)(fec_bitshreg & 0x0F))) return false;
            fec_bitstate = 0;
            fec_bitshreg = 0;
        }
    }
    return true;
}

static bool fec_send_code(const char* code, fec_sym_fn sym_out) {
    while (*code)
        if (!fec_send_bit((uint8_t)(*code++ - '0'), sym_out)) return false;
    return true;
}

// =========================================================================
//  ОБЩИЙ MFSK-ДВИЖОК
// =========================================================================
static uint8_t  mfsk_numtones = 0;
static uint32_t mfsk_next_deadline_us = 0;

void mfsk_prepare(uint32_t base_hz, double step_hz, uint8_t numtones) {
    if (numtones > MFSK_MAX_TONES) numtones = MFSK_MAX_TONES;
    mfsk_numtones = numtones;
		// ЕСЛИ СИНТЕЗАТОР ОТСУТСТВУЕТ - ИНИЦИАЛИЗИРУЕМ PIO ЯДРО И ВЫХОДИМ
    if (!device_SI[0]) {
        vfo_hardware_init(base_hz, step_hz);
        vfo_set_tone_instant(0);  
        if (debug_flag) {
            Serial.print(F("[MFSK] PIO готов, база "));
            Serial.print(base_hz); Serial.print(F(" Гц, шаг "));
            Serial.print(step_hz, 4); Serial.print(F(" Гц, тонов "));
            Serial.println(numtones);
        }
        return;  
    }

    // Если синтезатор установлен - расчет байт для Si5351
    uint64_t base_mHz = (uint64_t)base_hz * 1000ULL;  
    for (uint8_t i = 0; i < numtones; i++)  
        si_calculate_freq_bytes_mHz(base_mHz + (uint64_t)((double)i * step_hz * 1000.0 + 0.5),
                                    DATA_MFSK[i]);  
}  

static void mfsk_set_tone(uint8_t tone) {  
    if (tone >= mfsk_numtones) return;  
    if (device_SI[0] && SI_FAIL == false) setFrq_si5351(DATA_MFSK[tone]);  
    else                                  vfo_set_tone_instant(tone);  
}  

// Отсчёт дедлайнов заново от текущего момента (после пересчёта сетки и т.п.)
static inline void mfsk_sync_deadline() { mfsk_next_deadline_us = micros(); }

// Ожидание конца текущего символа по абсолютному дедлайну.
// led=true: красный LED в начале символа, гаснет на середине.
static bool mfsk_wait_symbol(uint32_t symbol_us, bool led) {
    uint32_t deadline = mfsk_next_deadline_us + symbol_us;
    uint32_t half_off_us = deadline - (symbol_us / 2);  
    bool led_half_off = !led;
    if (led) ZERO_LED_RED_ON();  
  
    while ((int32_t)(micros() - deadline) < 0) {  
        if (pc_file_written || soft_restart_flag) { ZERO_LED_OFF(); return false; }  
        if (Serial.available() > 0) { soft_restart_flag = true; ZERO_LED_OFF(); return false; }  
  
        if (!led_half_off && (int32_t)(micros() - half_off_us) >= 0) {  
            ZERO_LED_OFF();  
            led_half_off = true;  
        }  
  
        delayMicroseconds(20);  
        watchdog_update();  
    }  
    mfsk_next_deadline_us = deadline;  
    return true;  
}

bool mfsk_emit_tone(uint8_t tone, uint32_t symbol_us) {  
    mfsk_set_tone(tone);  
    return mfsk_wait_symbol(symbol_us, true);
}

static void mfsk_carrier(bool on) {
    if (device_SI[0]) { if (on) VFO_TX_ON(); else VFO_TX_OFF(); }
    else              vfo_operation_set(on);
}

static void mfsk_tx_begin() {
    vfo_set_narrowband(true);                 // глушим FRAC-дизер (как Olivia)  
    if (!device_SI[0]) {  
        vfo_operation_set(false);  
        vfo_set_tone_instant(0);  
        vfo_operation_set(true);  
    } else { VFO_TX_ON(); }  
    mfsk_sync_deadline();
}

static void mfsk_tx_end() {
    mfsk_carrier(false);
    vfo_set_narrowband(false);  
    ZERO_LED_OFF();  
    Serial.println("");  
}

static inline bool mfsk_abort() { return pc_file_written || soft_restart_flag; }

static inline void mfsk_echo(uint8_t c) {
    if (c >= ' ') Serial.print((char)c);
}

// =========================================================================
//  RSID (rsid.cxx: cRsId::Encode / cRsId::send)
// =========================================================================
static const uint8_t rsid_squares[256] = {
	0, 0, 0, 0, 0, 0, 0, 0, 0, 0, 0, 0, 0, 0, 0, 0,
	0, 1, 2, 3, 4, 5, 6, 7, 8, 9,10,11,12,13,14,15,
	0, 2, 4, 6, 8,10,12,14, 9,11,13,15, 1, 3, 5, 7,
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	0,15, 7, 8,14, 1, 9, 6, 5,10, 2,13,11, 4,12, 3
};
static const uint8_t rsid_indices[12] = { 2, 4, 8, 9, 11, 15, 7, 14, 5, 10, 13, 3 };

void rsid_encode(uint16_t code, uint8_t* rsid /*15*/) {
    rsid[0] = (uint8_t)(code >> 8);
    rsid[1] = (uint8_t)((code >> 4) & 0x0f);
    rsid[2] = (uint8_t)(code & 0x0f);
    for (int i = 3; i < RSID_NSYMBOLS; i++) rsid[i] = 0;
    for (int i = 0; i < 12; i++) {
        for (int j = RSID_NSYMBOLS - 1; j > 0; j--)
            rsid[j] = rsid[j - 1] ^ rsid_squares[(rsid[j] << 4) + rsid_indices[i]];
        rsid[0] = rsid_squares[(rsid[0] << 4) + rsid_indices[i]];
    }
}

// 5 символов тишины + 15 тонов: f = center - 7*step + tone*step.  
// Оставляет в mfsk_prepare сетку RSID — вызывающий восстанавливает свою.  
// Несущая гасится на границе последнего символа: между RSID и данными  
// в эфир не уходит «хвост» последнего тона на время перестройки сетки.  
bool rsid_send(uint16_t code, double center_hz) {  
    uint8_t rsid[RSID_NSYMBOLS];  
    rsid_encode(code, rsid);  
    mfsk_prepare((uint32_t)(center_hz - 7.0 * RSID_STEP_HZ + 0.5), RSID_STEP_HZ, 16);  
  
    // 5 символов тишины — несущая выключена  
    mfsk_carrier(false);  
    mfsk_sync_deadline();  
    for (int i = 0; i < 5; i++)  
        if (!mfsk_wait_symbol(RSID_SYMBOL_US, false)) return false;  
  
    // 15 символов RSID  
    mfsk_set_tone(rsid[0]);  
    mfsk_carrier(true);  
    for (int i = 0; i < RSID_NSYMBOLS; i++)  
        if (!mfsk_emit_tone(rsid[i], RSID_SYMBOL_US)) { mfsk_carrier(false); return false; }  
  
    // Последний тон отзвучал ровно на дедлайне — выключаем несущую,  
    // иначе rsid[14] продолжит звучать всё время vfo_hardware_init  
    // вызывающей стороны и декодер увидит лишний символ после RSID.  
    mfsk_carrier(false);  
    return true;  
}

// =========================================================================
//  THOR
// =========================================================================
void prepare_thor_frequencies(uint32_t base_hz) {
    THOR_Base_freq = base_hz;
    mfsk_prepare(base_hz - THOR_CENTER_OFFSET_HZ, THOR_STEP_HZ, THOR_NUMTONES);
}  
  
static uint8_t thor_prevtone = 0;  
  
static bool thor_send_symbol(uint8_t sym) {  
    uint8_t tone = (uint8_t)((thor_prevtone + sym + 2) % THOR_NUMTONES); // IFK+ (+2)  
    thor_prevtone = tone;  
#if THOR_INVERT_TONES  
    tone = (uint8_t)((THOR_NUMTONES - 1) - tone);  
#endif  
    return mfsk_emit_tone(tone, THOR_SYMBOL_US);  
}  
  
static bool thor_send_coded(uint8_t c, int secondary) {  
    return fec_send_code(thorvarienc(c, secondary), thor_send_symbol);
}  
  
void thor_send_char(char c) {  
    if (mfsk_abort()) return;  
    mfsk_echo((uint8_t)c);
    thor_send_coded((uint8_t)c, 0);  
}  
  
void thor_send_string(const char* str) {  
    if (str == nullptr) return;  
  
    fec_reset();
    thor_prevtone = 0;  
    mfsk_tx_begin();

    // RSID-маркер ДО преамбулы: fldigi переключит режим и отцентрует приём.  
    // Base_freq = центр полосы THOR (prepare_thor_frequencies уже вычла CENTER_OFFSET).  
    if (!rsid_send(THOR11_RSID_CODE, THOR_Base_freq)) goto done;  
    mfsk_prepare(THOR_Base_freq - THOR_CENTER_OFFSET_HZ, THOR_STEP_HZ, THOR_NUMTONES);  
    mfsk_sync_deadline();  
    mfsk_carrier(true);              // несущая гасится внутри rsid_send — включить для данных  

    // Преамбула (idle) — захват синхронизации декодером  
    for (int i = 0; i < THOR_PREAMBLE_CHARS && !mfsk_abort(); i++)  
        thor_send_coded(0, 0);  
  
    // Полезная нагрузка  
    while (*str && !mfsk_abort())  
        thor_send_char(*str++);  
  
    // Хвост — сброс перемежителя и свёрточного кодера  
    for (int i = 0; i < THOR_FLUSH_CHARS && !mfsk_abort(); i++)  
        thor_send_coded(0, 0);  
done:  
    mfsk_tx_end(); 
}  
  
void thor_send_string(String str) { thor_send_string(str.c_str()); }

// =========================================================================
//  MFSK16 (mfsk.cxx)
// =========================================================================
void prepare_mfsk16_frequencies(uint32_t base_hz) {
    MFSK16_Base_freq = base_hz;
    mfsk_prepare(base_hz - MFSK16_CENTER_OFFSET_HZ, MFSK16_STEP_HZ, MFSK16_NUMTONES);
}

// misc.cxx: grayencode
static inline uint8_t mfsk_grayencode(uint8_t data) {
    uint8_t bits = data;
    for (int i = 1; i < 8; i++) bits ^= (uint8_t)(data >> i);
    return bits;
}

// mfsk::sendsymbol: абсолютный тон = grayencode(sym), без IFK
static bool mfsk16_send_symbol(uint8_t sym) {
    return mfsk_emit_tone(mfsk_grayencode(sym & (MFSK16_NUMTONES - 1)), MFSK16_SYMBOL_US);
}

static inline bool mfsk16_send_bit(uint8_t bit) { return fec_send_bit(bit, mfsk16_send_symbol); }

static bool mfsk16_send_char(uint8_t c) {
    mfsk_echo(c);
    return fec_send_code(varienc(c), mfsk16_send_symbol);
}

void mfsk16_send_string(const char* str) {
    if (str == nullptr) return;
    fec_reset();
    mfsk_tx_begin();
		// Base_freq теперь = центр полосы (prepare_* вычитает CENTER_OFFSET)  
    if (!rsid_send(MFSK16_RSID_CODE, MFSK16_Base_freq)) goto done;  
    mfsk_prepare(MFSK16_Base_freq - MFSK16_CENTER_OFFSET_HZ, MFSK16_STEP_HZ, MFSK16_NUMTONES);
    mfsk_sync_deadline();

    // TX_STATE_PREAMBLE: clearbits() + preamble/3 нулевых бит
    for (int i = 0; i < MFSK16_PREAMBLE; i++) fec_send_bit(0, nullptr);
    for (int i = 0; i < MFSK16_PREAMBLE / 3; i++) if (!mfsk16_send_bit(0)) goto done;

    // TX_STATE_START: CR STX CR
    if (!fec_send_code(varienc('\r'), mfsk16_send_symbol)) goto done;
    if (!fec_send_code(varienc(2),    mfsk16_send_symbol)) goto done;
    if (!fec_send_code(varienc('\r'), mfsk16_send_symbol)) goto done;

    while (*str)
        if (!mfsk16_send_char((uint8_t)*str++)) goto done;

    // TX_STATE_FLUSH: CR EOT CR + flushtx(preamble)
    if (!fec_send_code(varienc('\r'), mfsk16_send_symbol)) goto done;
    if (!fec_send_code(varienc(4),    mfsk16_send_symbol)) goto done;
    if (!fec_send_code(varienc('\r'), mfsk16_send_symbol)) goto done;
    if (!mfsk16_send_bit(1)) goto done;
    for (int i = 0; i < MFSK16_PREAMBLE; i++) if (!mfsk16_send_bit(0)) goto done;

done:
    mfsk_tx_end();
}

void mfsk16_send_string(String str) { mfsk16_send_string(str.c_str()); }

// =========================================================================
//  DominoEX 8 (dominoex.cxx, без FEC)
// =========================================================================
void prepare_dominoex_frequencies(uint32_t base_hz) {
    DOMINOEX_Base_freq = base_hz;
    mfsk_prepare(base_hz - DOMEX_CENTER_OFFSET_HZ, DOMEX8_STEP_HZ, DOMEX_NUMTONES);
}

static uint8_t domex_prevtone = 0;

static bool domex_send_symbol(uint8_t sym) {
    uint8_t tone = (uint8_t)((domex_prevtone + 2 + sym) % DOMEX_NUMTONES);   // IFK+
    domex_prevtone = tone;
    return mfsk_emit_tone(tone, DOMEX8_SYMBOL_US);
}

// dominoex::sendchar: первый nibble всегда, продолжения — пока установлен 0x8
static bool domex_send_char(uint8_t c, bool secondary) {
    const uint8_t* code = domino_varicode[c + (secondary ? 256 : 0)];
    if (!domex_send_symbol(code[0])) return false;
    for (int k = 1; k < 3; k++) {
        if (!(code[k] & 0x8)) break;
        if (!domex_send_symbol(code[k])) return false;
    }
    return true;
}

static inline bool domex_send_idle() { return domex_send_char(0, true); }   // secondary NUL

void dominoex_send_string(const char* str) {
    if (str == nullptr) return;
    domex_prevtone = 0;
    mfsk_tx_begin();

		if (!rsid_send(DOMEX8_RSID_CODE, DOMINOEX_Base_freq)) goto done;  
    mfsk_prepare(DOMINOEX_Base_freq - DOMEX_CENTER_OFFSET_HZ, DOMEX8_STEP_HZ, DOMEX_NUMTONES);
    mfsk_sync_deadline();

    if (!domex_send_idle()) goto done;                                      // PREAMBLE
    if (!domex_send_char('\r', false) || !domex_send_char(2, false) ||
        !domex_send_char('\r', false)) goto done;                           // START

    while (*str) {
        mfsk_echo((uint8_t)*str);
        if (!domex_send_char((uint8_t)*str++, false)) goto done;
    }

    if (!domex_send_char('\r', false) || !domex_send_char(4, false) ||
        !domex_send_char('\r', false)) goto done;                           // END
    for (int i = 0; i < 4; i++) if (!domex_send_idle()) goto done;          // FLUSH

done:
    mfsk_tx_end();
}

void dominoex_send_string(String str) { dominoex_send_string(str.c_str()); }

// =========================================================================
//  FSQ (fsq.cxx, недиректный режим: " " BOL "<call>:" текст EOL)
// =========================================================================
#define FSQBOL " \n"
#define FSQEOL "\n "

void prepare_fsq_frequencies(uint32_t base_hz) {
    FSQ_Base_freq = base_hz;
    mfsk_prepare(base_hz - FSQ_CENTER_OFFSET_HZ, FSQ_STEP_HZ, FSQ_NUMTONES);
}

static uint8_t fsq_prevtone = 0;

static bool fsq_send_symbol(uint8_t sym) {
    uint8_t tone = (uint8_t)((fsq_prevtone + sym + 1) % FSQ_NUMTONES);    // IFK+
    fsq_prevtone = tone;
    return mfsk_emit_tone(tone, FSQ_SYMBOL_US);
}

// fsq::send_char: 0 -> idle (28,30); иначе sym1, и sym2 только если > 28
static bool fsq_send_char(uint8_t c) {
    if (c == 0) return fsq_send_symbol(28) && fsq_send_symbol(30);
    uint8_t sym1 = fsq_varicode[c][0];
    uint8_t sym2 = fsq_varicode[c][1];
    if (!fsq_send_symbol(sym1)) return false;
    if (sym2 > 28 && !fsq_send_symbol(sym2)) return false;
    return true;
}

static bool fsq_send_cstr(const char* s) {
    while (*s) if (!fsq_send_char((uint8_t)*s++)) return false;
    return true;
}

void fsq_send_string(const char* str) {
    if (str == nullptr) return;
    fsq_prevtone = 0;
    mfsk_tx_begin();   // сетка уже задана prepare_fsq_frequencies()  
  
    // RSID до BOT — сетку RSID (16 тонов) заменяем обратно на сетку FSQ  
    if (!rsid_send(FSQ_RSID_CODE, (double)FSQ_Base_freq)) goto done;  
    mfsk_prepare(FSQ_Base_freq - FSQ_CENTER_OFFSET_HZ, FSQ_STEP_HZ, FSQ_NUMTONES);  
    mfsk_sync_deadline();  
    mfsk_carrier(true);          // rsid_send гасит несущую — включаем на BOT  
  
    // BOT: " " + FSQBOL + mycall + ":" (без CRC — недиректный режим)  
    if (!fsq_send_cstr(" " FSQBOL)) goto done;
    if (!fsq_send_cstr(my_call_variable.c_str())) goto done;
    if (!fsq_send_char(':')) goto done;

    // CR в fsq_varicode отсутствует (={0,0} -> пробел) — переводы строк только LF
    while (*str) {
        uint8_t c = (uint8_t)*str++;
        if (c == '\r') continue;
        mfsk_echo(c);
        if (!fsq_send_char(c)) goto done;
    }

    fsq_send_cstr(FSQEOL);

done:
    mfsk_tx_end();
}

void fsq_send_string(String str) { fsq_send_string(str.c_str()); }
